## firmware/components/hi-can/Kconfig.projbuild
```kconfig
menu "Hi-CAN Configuration"
    config HI_CAN_BUS_RECOVERY_INTERVAL
        int "Bus-off recovery interval (ms)"
        default "1000"
        range "0" "60000"
        help
            Minimum time between bus-off recoveries. The first recovery starts
            straight away; a node that keeps going bus-off (e.g. a wiring fault)
            retries at most this often, so it can't flood the bus with error frames.
    
    config HI_CAN_BUS_TX_TIME
        int "TX message maximum queue time"
        default "100"
        range "0" "10000"
        help
            Time to wait in ms to attempt to queue a packet transmission. If the
            queue is still full, the packet is dropped. 0 never waits.
    
    choice HI_CAN_BUS_BAUD_RATE
        prompt "Baud rate"
        default HI_CAN_BAUD_500K
        help
            CAN bus baud rate

        config HI_CAN_BAUD_1M
            bool "1Mbaud"
        config HI_CAN_BAUD_500K
            bool "500kbaud"
        config HI_CAN_BAUD_250K
            bool "250kbaud"
        config HI_CAN_BAUD_125K
            bool "125kbaud"
    endchoice

    config HI_CAN_NO_ACK
        bool "Do not require acknowledgments"
        default n
        help
            If enabled, will not require acknowledgments from other nodes (useful for debugging when disconnected from the bus)
endmenu
```
